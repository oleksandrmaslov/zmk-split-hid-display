/* The raw_hid shield provides this node by default. Use this only as a custom override. */

/ {
    rawhid_or: rawhid_or {
        compatible = "zmk,split-peripheral-output-relay";
        relay-channel = <1>;
        device = <&nice_view>;
    };
};
